## main/Kconfig
```kconfig
menu "Done Main Config"    

    choice DONE_BOARDS
        prompt "Select your development board"
        
        config DONE_TEST_C6
            bool "Test C6"

        config DONE_TEST_C3
            bool "Test C3"
    endchoice        
         
    config DONE_PARTITION_TABLE_CUSTOM
        bool 
        depends on PARTITION_TABLE_CUSTOM     
        default y 

    config DONE_PARTITION_TABLE_CUSTOM_FILENAME           
        string         
        default "partitions_c6.csv"     if DONE_TEST_C6 
        default "partitions_c3.csv"     if DONE_TEST_C3                                             
                           

    menu "Done Firmware components"         
        config DONE_LOG
            bool "Log Utility"        
            default y  

        config DONE_LOG_PRINT
            bool "Print Log"        
            depends on DONE_LOG
            default n  

        config DONE_COMPONENT_MQTT
            bool "MQTT component"        
            default y   

        config DONE_COMPONENT_MQTT_DEFAULT
            bool "MQTTS defalut settup"        
            depends on DONE_COMPONENT_MQTT
            default y                              
    endmenu                 
endmenu
```
